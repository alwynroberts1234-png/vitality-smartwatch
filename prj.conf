## CMakeLists.txt
```
cmake_minimum_required(VERSION 3.20)
option(VITALITY_HOST_TESTS "Build portable core tests without Zephyr" OFF)
set(CORE_SOURCES src/app/state.c src/assets/asset_manager.c src/sensors/simulator.c src/vitality/engine.c)
if(VITALITY_HOST_TESTS)
  project(vitality_core C)
  enable_testing()
  add_executable(core_tests tests/core_tests.c ${CORE_SOURCES})
  target_include_directories(core_tests PRIVATE include)
  target_compile_features(core_tests PRIVATE c_std_99)
  if(MSVC)
    target_compile_options(core_tests PRIVATE /W4)
  else()
    target_compile_options(core_tests PRIVATE -Wall -Wextra -Werror)
  endif()
  add_test(NAME core COMMAND core_tests)
else()
  find_package(Zephyr REQUIRED HINTS $ENV{ZEPHYR_BASE})
  project(vitality_watch)
  target_include_directories(app PRIVATE include)
  target_sources(app PRIVATE src/main.c src/app/event_bus.c ${CORE_SOURCES})
  target_sources_ifdef(CONFIG_VITALITY_UI app PRIVATE src/ui/ui_manager.c)
  target_sources_ifdef(CONFIG_VITALITY_QSPI_ASSETS app PRIVATE src/storage/qspi.c src/assets/lvgl_qspi_fs.c)
endif()
```

## Kconfig
```
mainmenu "Vitality Watch"
source "Kconfig.zephyr"
menu "Vitality"
config VITALITY_SENSOR_SIMULATOR
    bool "Explicitly simulated health data"
    default y
config VITALITY_UI
    bool "LVGL watch UI (requires board display)"
    depends on DISPLAY && LVGL
    default n
config VITALITY_QSPI_ASSETS
    bool "Read-only QSPI asset pack through Q:"
    depends on VITALITY_UI && FLASH_MAP
    default n
    help
      Requires a vitality_assets_partition fixed partition on external flash.
      The pack must be provisioned separately. Never formats flash.
endmenu
```

## west.yml
```
manifest:
  version: "0.13"
  projects:
    - name: zephyr
      url: https://github.com/zephyrproject-rtos/zephyr
      revision: v4.1.0
      import: true
  self:
    path: vitality-watch
```

## prj.conf
```kconfig
# Headless nRF52840 DK milestone: no unknown panel or sensor wiring.
CONFIG_LOG=y
CONFIG_MAIN_STACK_SIZE=4096
CONFIG_VITALITY_SENSOR_SIMULATOR=y
CONFIG_HEAP_MEM_POOL_SIZE=0
```

## src/main.c
```c
#include "vitality.h"
#include <zephyr/kernel.h>
#include <zephyr/logging/log.h>
LOG_MODULE_REGISTER(vitality, LOG_LEVEL_INF);
#ifdef CONFIG_VITALITY_SENSOR_SIMULATOR
static void sensor_thread(void *a, void *b, void *c) {
    ARG_UNUSED(a); ARG_UNUSED(b); ARG_UNUSED(c);
    for (;;) {
        app_event_t event = {.type = EV_SENSOR};
        sensor_simulate(&event.sensors, (uint64_t)k_uptime_get());
        if (event_post(&event)) LOG_WRN("Sensor event queue full");
        k_sleep(K_SECONDS(1));
    }
}
K_THREAD_DEFINE(sensor_tid, 1536, sensor_thread, NULL, NULL, NULL, 7, 0, 0);
#endif
int main(void) {
    watch_state_t state;
    watch_init(&state);
    LOG_INF("Vitality prototype: unavailable hardware remains invalid");
#ifdef CONFIG_VITALITY_UI
    if (ui_init()) { LOG_ERR("Display initialization failed"); return 0; }
    ui_render(&state);
#endif
    for (;;) {
        app_event_t event;
        int wait_ms = state.power == POWER_SLEEP ? 1000 : 25;
        if (!event_take(&event, wait_ms)) {
            watch_dispatch(&state, &event);
            if (event.type == EV_SENSOR) {
                LOG_INF("%s HR=%u steps=%u vitality=%u valid=%u",
                    state.sensors.simulated ? "SIMULATED" : "HARDWARE",
                    state.sensors.heart_bpm, state.sensors.steps,
                    state.vitality, state.score_valid);
            }
#ifdef CONFIG_VITALITY_UI
            ui_render(&state);
#endif
        }
#ifdef CONFIG_VITALITY_UI
        if (state.power != POWER_SLEEP) ui_poll();
#endif
    }
}
```

## include/asset_manager.h
```c
#ifndef ASSET_MANAGER_H
#define ASSET_MANAGER_H
#include <stdint.h>
#include <stddef.h>
#define ASSET_ENTRY_SIZE 80u
#define ASSET_HEADER_SIZE 16u
#define ASSET_MAX_COUNT 128u
/* VPK1 little-endian: header magic,count,total size,version.
 * Each entry: UTF-8 name[64], offset u32, size u32, CRC32 u32,
 * width u16,height u16. Payload is opaque: .bin is LVGL v9 RGB565. */
typedef int (*asset_reader_t)(void *context, uint32_t offset, void *dst, size_t size);
typedef struct { asset_reader_t read; void *context; uint32_t capacity, total, count; } asset_store_t;
typedef struct { uint32_t offset, size, crc; uint16_t width, height; } asset_info_t;
int asset_mount(asset_store_t *store, asset_reader_t read, void *context, uint32_t capacity);
int asset_find(const asset_store_t *store, const char *name, asset_info_t *info);
int asset_read(const asset_store_t *store, const asset_info_t *info, uint32_t offset, void *dst, size_t size);
int asset_verify(const asset_store_t *store, const asset_info_t *info);
int qspi_assets_init(void);
extern asset_store_t qspi_assets;
void lvgl_qspi_register(void);
#endif
```

## include/vitality.h
```c
#ifndef VITALITY_H
#define VITALITY_H
#include <stdbool.h>
#include <stdint.h>
#include <stddef.h>
#define VITALITY_WIDTH 466
#define VITALITY_HEIGHT 466
#define VITALITY_EVENT_CAPACITY 16
typedef enum { SCREEN_HOME, SCREEN_VITALITY, SCREEN_HEART, SCREEN_ACTIVITY,
    SCREEN_ENVIRONMENT, SCREEN_SETTINGS, SCREEN_COUNT } screen_t;
typedef enum { POWER_ACTIVE, POWER_IDLE, POWER_SLEEP, POWER_WORKOUT } power_state_t;
typedef enum { EV_NEXT, EV_PREVIOUS, EV_HOME, EV_WAKE, EV_IDLE, EV_SLEEP,
    EV_WORKOUT_TOGGLE, EV_THEME_NEXT, EV_SENSOR } event_type_t;
enum { VALID_HEART=1u, VALID_SPO2=2u, VALID_STEPS=4u, VALID_SKIN=8u,
    VALID_ENVIRONMENT=16u, VALID_BATTERY=32u };
typedef struct {
    uint64_t timestamp_ms;
    uint32_t valid;
    bool simulated;
    uint16_t heart_bpm, spo2_x100;
    uint32_t steps;
    int16_t skin_c_x100, ambient_c_x100;
    uint16_t humidity_x100;
    uint32_t pressure_pa;
    int32_t altitude_cm;
    int32_t accel_mg[3], gyro_mdps[3], magnetic_nt[3];
    uint16_t heading_x100, battery_mv;
    uint8_t battery_percent;
} sensor_snapshot_t;
typedef struct { event_type_t type; sensor_snapshot_t sensors; } app_event_t;
typedef struct {
    screen_t screen;
    power_state_t power;
    uint8_t theme;
    bool workout_active;
    bool score_valid;
    uint8_t vitality, movement, recovery, heart, sleep, balance;
    sensor_snapshot_t sensors;
} watch_state_t;
typedef struct {
    int (*init)(void);
    int (*start)(void);
    int (*stop)(void);
    int (*read)(sensor_snapshot_t *sample);
    int (*set_rate)(uint32_t hz);
    int (*suspend)(void);
    int (*resume)(void);
} sensor_driver_api_t;
void watch_init(watch_state_t *state);
void watch_dispatch(watch_state_t *state, const app_event_t *event);
void vitality_update(watch_state_t *state);
void sensor_simulate(sensor_snapshot_t *sample, uint64_t uptime_ms);
int event_post(const app_event_t *event);
int event_take(app_event_t *event, int32_t timeout_ms);
int ui_init(void);
void ui_render(const watch_state_t *state);
void ui_poll(void);
#endif
```
